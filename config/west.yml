## config/west.yml
```yaml
manifest:
  remotes:
    - name: zmkfirmware
      # url-base: https://github.com/zmkfirmware
      url-base: https://github.com/caksoylar
  projects:
    - name: zmk
      remote: zmkfirmware
      # revision: main
      # revision: caksoylar/zen-v2
      revision: caksoylar/zen-8bit
      import: app/west.yml
  self:
    path: config
```
